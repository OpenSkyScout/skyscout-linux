## arch/arm/configs/skyscout_defconfig
```kconfig
# CONFIG_LOCALVERSION_AUTO is not set
CONFIG_LOCALVERSION="-skyscout"
CONFIG_KERNEL_GZIP=y
CONFIG_SYSVIPC=y
CONFIG_LOG_BUF_SHIFT=14
CONFIG_CC_OPTIMIZE_FOR_SIZE=y
CONFIG_EXPERT=y
# CONFIG_KALLSYMS is not set
# CONFIG_ELF_CORE is not set
# CONFIG_SHMEM is not set
# CONFIG_AIO is not set
# CONFIG_IO_URING is not set
# CONFIG_SWAP is not set
CONFIG_SLOB=y
CONFIG_ARCH_MULTI_V4T=y
# CONFIG_ARCH_MULTI_V7 is not set
CONFIG_ARCH_S3C24XX=y
CONFIG_CPU_S3C2410=y
CONFIG_MACH_SKYSCOUT=y
CONFIG_UNUSED_BOARD_FILES=y
CONFIG_AEABI=y
CONFIG_CMDLINE="earlycon console=ttySAC0,9600n8 console=tty0 root=/dev/mmcblk0p2 rootwait ro"
CONFIG_CMDLINE_FORCE=y
# CONFIG_BLK_DEV_INITRD is not set
# CONFIG_MODULES is not set
CONFIG_PARTITION_ADVANCED=y
CONFIG_MSDOS_PARTITION=y
# CONFIG_NET is not set
CONFIG_MTD=y
CONFIG_MTD_OF_PARTS=y
CONFIG_MTD_RAW_NAND=y
CONFIG_MTD_NAND_S3C2410=y
# CONFIG_MTD_BLOCK is not set
# CONFIG_MTD_BLOCK_RO is not set
CONFIG_INPUT=y
CONFIG_INPUT_EVDEV=y
CONFIG_INPUT_EVBUG=y
CONFIG_INPUT_KEYBOARD=y
CONFIG_KEYBOARD_GPIO_POLLED=y
# CONFIG_INPUT_MOUSE is not set
# CONFIG_SERIO is not set
CONFIG_VT=y
CONFIG_VT_CONSOLE=y
CONFIG_SERIAL_SAMSUNG=y
CONFIG_SERIAL_SAMSUNG_CONSOLE=y
# CONFIG_HW_RANDOM is not set
# CONFIG_HWMON is not set
CONFIG_FB=y
CONFIG_FB_S3C2410=y
CONFIG_FRAMEBUFFER_CONSOLE=y
CONFIG_FRAMEBUFFER_CONSOLE_DETECT_PRIMARY=y
CONFIG_FONTS=y
CONFIG_FONT_MINI_4x6=y
# CONFIG_LOGO is not set
CONFIG_MMC=y
CONFIG_MMC_BLOCK=y
CONFIG_S3C24XX_DMAC=y
CONFIG_MMC_S3C=y
CONFIG_MMC_S3C_PIO=y
# CONFIG_USB_SUPPORT is not set
# CONFIG_SOUND is not set
CONFIG_EXT4_FS=y
CONFIG_VFAT_FS=y
CONFIG_PROC_FS=y
CONFIG_SYSFS=y
CONFIG_TMPFS=y
# CONFIG_MISC_FILESYSTEMS is not set
```
